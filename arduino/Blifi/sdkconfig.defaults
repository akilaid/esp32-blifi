## firmware/components/blifi/Kconfig.projbuild
```kconfig
menu "Blifi Provisioning"

    menu "Hard Reset Indicator"

        config BLIFI_RESET_INDICATOR_ENABLE
            bool "Drive a GPIO when a hard reset is detected"
            default n
            help
                Optional. When enabled, blifi drives a GPIO
                active on the boot following a reset-pin hard reset - wire
                an LED, relay, or optocoupler to it as a "credentials were wiped"
                signal, with no application code required.

                When disabled (default) the entire feature - GPIO config, timer,
                drive logic - compiles out and behavior is unchanged.

        config BLIFI_RESET_INDICATOR_GPIO
            int "Indicator GPIO number"
            depends on BLIFI_RESET_INDICATOR_ENABLE
            default 2
            help
                Output pin driven when a hard reset is detected. GPIO2 is the
                onboard LED on many ESP32 devkits (handy for a quick demo).

        choice BLIFI_RESET_INDICATOR_ACTIVE_LEVEL
            prompt "Indicator active level"
            depends on BLIFI_RESET_INDICATOR_ENABLE
            default BLIFI_RESET_INDICATOR_ACTIVE_HIGH
            help
                The level driven when the indicator is asserted. Use active-low for
                an LED wired to VCC or an optocoupler expecting an active-low input.

            config BLIFI_RESET_INDICATOR_ACTIVE_HIGH
                bool "Active high"

            config BLIFI_RESET_INDICATOR_ACTIVE_LOW
                bool "Active low"
        endchoice

        config BLIFI_RESET_INDICATOR_PULSE_MS
            int "Pulse duration in milliseconds (0 = until re-provisioned)"
            depends on BLIFI_RESET_INDICATOR_ENABLE
            default 2000
            help
                How long the pin stays asserted. A fixed duration (default 2000 ms)
                suits an LED blink or optocoupler pulse. Set 0 to hold the pin
                asserted until the device is re-provisioned and back online
                (the state machine reaches CONNECTED) - e.g. for a relay.

    endmenu

    config BLIFI_FIXED_POP
        string "Fixed Proof-of-Possession (empty = auto-generate)"
        default ""
        help
            If non-empty, the device uses this exact 8-character Crockford base32
            PoP (digits 0-9 and A-Z excluding I, L, O, U) instead of generating a
            random one on first boot and storing it in NVS.

            Validated at build time: a wrong length or an invalid character fails
            the build. Leave empty (default) to keep the auto-generated,
            NVS-persisted PoP.

            Note: reusing one PoP across many devices weakens the per-device
            guarantee; prefer a value that is unique per unit.

    config BLIFI_STOP_BLE_AFTER_PROVISIONING
        bool "Stop BLE after successful provisioning"
        default n
        help
            When enabled, blifi tears the BLE stack down once provisioning
            succeeds and the phone has received the device IP - freeing the
            NimBLE host RAM and leaving nothing advertising or connectable. The
            Wi-Fi give-up path still brings BLE back for re-provisioning.

            When disabled (default), BLE stays up after provisioning until the
            next reboot, exactly as before. This is the compile-time default for
            blifi_config_t.stop_ble_after_provisioning; it can also be set per
            call at runtime.

endmenu
```
